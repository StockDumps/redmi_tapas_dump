/dts-v1/;

/ {
	model = "Qualcomm Technologies, Inc. KHAJE IDP nopmi topaz";
	compatible = "qcom,khaje-idp\0qcom,khaje\0qcom,idp";
	qcom,msm-id = <0x24a 0x10000>;
	qcom,board-id = <0x30022 0x00>;
	qcom,pmic-id = <0x2d 0x00 0x00 0x00>;

	fragment@0 {
		target = <0xffffffff>;

		__overlay__ {

			pm6125-tz {

				cooling-maps {

					trip0_cpu0 {
						trip = <0xffffffff>;
						cooling-device = <0xffffffff 0x07 0x07>;
					};

					trip0_cpu4 {
						trip = <0xffffffff>;
						cooling-device = <0xffffffff 0x06 0xffffffff>;
					};

					trip1_cpu1 {
						trip = <0xffffffff>;
						cooling-device = <0xffffffff 0x01 0x01>;
					};

					trip1_cpu2 {
						trip = <0xffffffff>;
						cooling-device = <0xffffffff 0x01 0x01>;
					};

					trip1_cpu3 {
						trip = <0xffffffff>;
						cooling-device = <0xffffffff 0x01 0x01>;
					};

					trip1_cpu4 {
						trip = <0xffffffff>;
						cooling-device = <0xffffffff 0x01 0x01>;
					};

					trip1_cpu5 {
						trip = <0xffffffff>;
						cooling-device = <0xffffffff 0x01 0x01>;
					};

					trip1_cpu6 {
						trip = <0xffffffff>;
						cooling-device = <0xffffffff 0x01 0x01>;
					};

					trip1_cpu7 {
						trip = <0xffffffff>;
						cooling-device = <0xffffffff 0x01 0x01>;
					};
				};
			};
		};
	};

	fragment@1 {
		target = <0xffffffff>;

		__overlay__ {

			fpc1020 {
				status = "ok";
				compatible = "fpc,fpc1020";
				interrupt-parent = <0xffffffff>;
				interrupts = <0x53 0x00>;
				fpc,gpio_rst = <0xffffffff 0x68 0x00>;
				fpc,gpio_irq = <0xffffffff 0x53 0x00>;
				fpc,gpio_vdd_for_plsensor = <0xffffffff 0x41 0x00>;
				vcc_spi-supply = <0xffffffff>;
				vdd_io-supply = <0xffffffff>;
				vdd_ana-supply = <0xffffffff>;
				fpc,enable-on-boot;
				pinctrl-names = "fpc1020_reset_reset\0fpc1020_reset_active\0fpc1020_irq_active";
				pinctrl-0 = <0x01>;
				pinctrl-1 = <0x02>;
				pinctrl-2 = <0x03>;
			};

			goodix_fp {
				compatible = "goodix,fingerprint";
				interrupt-parent = <0xffffffff>;
				interrupt = <0x53 0x00>;
				vcc_spi_supply = <0xffffffff>;
				vcc_ana_supply = <0xffffffff>;
				vdd_io-supply = <0xffffffff>;
				fp-gpio-irq = <0xffffffff 0x53 0x00>;
				fp-gpio-reset = <0xffffffff 0x68 0x00>;
				fp-gpio-pwr = <0xffffffff 0x41 0x00>;
				pinctrl-names = "goodix_reset_outputlow\0goodix_reset_outputhigh\0goodix_pwr_outputlow\0goodix_pwr_outputhigh";
				pinctrl-0 = <0x01>;
				pinctrl-1 = <0x02>;
				pinctrl-2 = <0x04>;
				pinctrl-3 = <0x05>;
				status = "okay";
			};
		};
	};

	fragment@2 {
		target = <0xffffffff>;

		__overlay__ {

			msm_gpio_104 {
				phandle = <0x01>;

				mux {
					pins = "gpio104";
					function = "gpio";
				};

				config {
					pins = "gpio104";
					drive-strength = <0x02>;
					bias-disable;
					output-low;
				};
			};

			msm_gpio_104_output_high {
				phandle = <0x02>;

				mux {
					pins = "gpio104";
					function = "gpio";
				};

				config {
					pins = "gpio104";
					drive-strength = <0x02>;
					bias-disable;
					output-high;
				};
			};

			msm_gpio_83 {
				phandle = <0x03>;

				mux {
					pins = "gpio83";
					function = "gpio";
				};

				config {
					pins = "gpio83";
					drive-strength = <0x02>;
					bias-pull-down;
				};
			};

			msm_gpio_65 {
				phandle = <0x04>;

				mux {
					pins = "gpio65";
					function = "gpio";
				};

				config {
					pins = "gpio65";
					drive-strength = <0x02>;
					bias-disable;
					output-low;
				};
			};

			msm_gpio_65_output_high {
				phandle = <0x05>;

				mux {
					pins = "gpio65";
					function = "gpio";
				};

				config {
					pins = "gpio65";
					drive-strength = <0x02>;
					bias-disable;
					output-high;
				};
			};
		};
	};

	fragment@3 {
		target = <0xffffffff>;

		__overlay__ {
			pinctrl-0 = <0xffffffff 0xffffffff 0x06>;

			rf_pa1_therm {
				reg = <0x55>;
				label = "rf_pa1_therm";
				qcom,ratiometric;
				qcom,hw-settle-time = <0xc8>;
				qcom,pre-scaling = <0x01 0x01>;
			};
		};
	};

	fragment@4 {
		target = <0xffffffff>;

		__overlay__ {
			status = "ok";

			rf_pa1_therm {
				reg = <0x03>;
				io-channels = <0xffffffff 0x55>;
				qcom,ratiometric;
				qcom,hw-settle-time-us = <0xc8>;
			};
		};
	};

	fragment@5 {
		target = <0xffffffff>;

		__overlay__ {

			rf-pa1-therm-usr {
				polling-delay-passive = <0x00>;
				polling-delay = <0x00>;
				thermal-governor = "user_space";
				thermal-sensors = <0xffffffff 0x03>;
				wake-capable-sensor;

				trips {

					active-config0 {
						temperature = <0x1e848>;
						hysteresis = <0x3e8>;
						type = "passive";
					};
				};
			};
		};
	};

	fragment@6 {
		target = <0xffffffff>;

		__overlay__ {

			oled_vci {

				oled_vci_default {
					pins = "gpio9";
					function = "normal";
					input-disable;
					power-source = <0x00>;
					bias-disable;
					output-high;
					qcom,drive-strength = <0x02>;
					phandle = <0x17>;
				};

				oled_vci_suspend {
					pins = "gpio9";
					function = "normal";
					input-disable;
					power-source = <0x00>;
					bias-disable;
					output-low;
					qcom,drive-strength = <0x02>;
					phandle = <0x18>;
				};
			};

			rf_pa1_therm {

				rf_pa1_therm_default {
					pins = "gpio7";
					bias-high-impedance;
					phandle = <0x06>;
				};
			};

			vib_out_gpio8 {

				vib_out_gpio8_default {
					pins = "gpio8";
					function = "normal";
					bias-pull-up;
					power-source = <0x00>;
					phandle = <0x08>;
				};
			};

			key_vol_up {

				key_vol_up_default {
					pins = "gpio5";
					function = "normal";
					input-enable;
					bias-pull-up;
					power-source = <0x00>;
					phandle = <0x07>;
				};
			};

			eldo9_pin {

				gpio@c000 {
					pins = "gpio1";
					function = "normal";
					qcom,drive-strength = <0x02>;
					power-source = <0x00>;
					bias-disable;
					output-high;
					phandle = <0x09>;
				};
			};
		};
	};

	fragment@7 {
		target = <0xffffffff>;

		__overlay__ {

			gpio_keys {
				compatible = "gpio-keys";
				label = "gpio-keys";
				pinctrl-names = "default";
				pinctrl-0 = <0x07>;

				vol_up {
					label = "volume_up";
					gpios = <0xffffffff 0x05 0x01>;
					linux,input-type = <0x01>;
					linux,code = <0x73>;
					linux,can-disable;
					debounce-interval = <0x0f>;
					gpio-key,wakeup;
				};
			};

			ant_check {
				compatible = "ant_check";
				interrupt-parent = <0xffffffff>;
				ant_check_gpio = <0xffffffff 0x6b 0x00>;
				pinctrl-names = "default";
				pinctrl-0 = <0xffffffff>;
			};

			ant_check_div {
				compatible = "ant_check_div";
				interrupt-parent = <0xffffffff>;
				ant_check_div_gpio = <0xffffffff 0x19 0x00>;
				pinctrl-names = "default";
				pinctrl-0 = <0xffffffff>;
			};

			vibrator_gpio {
				status = "ok";
				compatible = "qcom,qpnp-vibrator-ldo-tz";
				pinctrl-names = "default";
				pinctrl-0 = <0x08>;
				vib,en-gpio = <0xffffffff 0x08 0x01>;
			};

			vdda_usb_ss_dp_core {
				compatible = "regulator-fixed";
				regulator-name = "vdd_supply";
				regulator-min-microvolt = <0xd6d80>;
				regulator-max-microvolt = <0xd6d80>;
				enable-active-high;
				gpio = <0xffffffff 0x01 0x00>;
				pinctrl-names = "default";
				pinctrl-0 = <0x09>;
				phandle = <0x0a>;
			};
		};
	};

	fragment@8 {
		target = <0xffffffff>;

		__overlay__ {
			vdd-supply = <0x0a>;
		};
	};

	fragment@9 {
		target = <0xffffffff>;

		__overlay__ {
			vdd-supply = <0xffffffff>;
			qcom,vdd-voltage-level = <0x2d2a80 0x2d2a80>;
			qcom,vdd-current-level = <0x00 0x8b290>;
			vdd-io-supply = <0xffffffff>;
			qcom,vdd-io-always-on;
			qcom,vdd-io-lpm-sup;
			qcom,vdd-io-voltage-level = <0x1b7740 0x1b7740>;
			qcom,vdd-io-current-level = <0x00 0x4f588>;
			pinctrl-names = "default\0sleep";
			pinctrl-0 = <0xffffffff>;
			pinctrl-1 = <0xffffffff>;
			status = "ok";
		};
	};

	fragment@10 {
		target = <0xffffffff>;

		__overlay__ {
			vdd-supply = <0xffffffff>;
			qcom,vdd-voltage-level = <0x2d2a80 0x2d2a80>;
			qcom,vdd-current-level = <0x00 0xc3500>;
			vdd-io-supply = <0xffffffff>;
			qcom,vdd-io-voltage-level = <0x1b7740 0x2d2a80>;
			qcom,vdd-io-current-level = <0x00 0x55f0>;
			vdd-io-bias-supply = <0xffffffff>;
			qcom,vdd-io-bias-voltage-level = <0x132a40 0x132a40>;
			qcom,vdd-io-bias-current-level = <0x00 0x1770>;
			pinctrl-names = "default\0sleep";
			pinctrl-0 = <0xffffffff>;
			pinctrl-1 = <0xffffffff>;
			cd-gpios = <0xffffffff 0x58 0x01>;
			status = "ok";
		};
	};

	fragment@11 {
		target = <0xffffffff>;

		__overlay__ {
			compatible = "qcom,ufs-phy-qmp-v4-khaje";
			vdda-phy-supply = <0xffffffff>;
			vdda-pll-supply = <0xffffffff>;
			vdda-phy-max-microamp = <0x14ec4>;
			vdda-pll-max-microamp = <0x477c>;
			status = "ok";
		};
	};

	fragment@12 {
		target = <0xffffffff>;

		__overlay__ {
			vdd-hba-supply = <0xffffffff>;
			vdd-hba-fixed-regulator;
			vcc-supply = <0xffffffff>;
			vcc-max-microamp = "\0\f5";
			vccq2-supply = <0xffffffff>;
			vccq2-max-microamp = "\0\f5";
			qcom,vddp-ref-clk-supply = <0xffffffff>;
			qcom,vddp-ref-clk-max-microamp = <0x64>;
			reset-gpios = <0xffffffff 0x71 0x01>;
			reset-names = "rst";
			status = "ok";
		};
	};

	fragment@13 {
		target = <0xffffffff>;

		__overlay__ {
			status = "ok";
		};
	};

	fragment@14 {
		target = <0xffffffff>;

		__overlay__ {
			status = "okay";
			qcom,i2c-touch-active = "synaptics,tcm-i2c";

			synaptics_tcm@20 {
				compatible = "synaptics,tcm-i2c";
				reg = <0x20>;
				interrupt-parent = <0xffffffff>;
				interrupts = <0x50 0x2008>;
				pinctrl-names = "pmx_ts_active\0pmx_ts_suspend\0pmx_ts_release";
				pinctrl-0 = <0xffffffff 0xffffffff>;
				pinctrl-1 = <0xffffffff 0xffffffff>;
				pinctrl-2 = <0xffffffff>;
				synaptics,irq-gpio = <0xffffffff 0x50 0x2008>;
				synaptics,irq-on-state = <0x00>;
				synaptics,reset-gpio = <0xffffffff 0x56 0x00>;
				synaptics,reset-on-state = <0x00>;
				synaptics,reset-active-ms = <0x14>;
				synaptics,reset-delay-ms = <0xc8>;
				synaptics,power-delay-ms = <0xc8>;
				synaptics,ubl-i2c-addr = <0x20>;
				synaptics,extend_report;
				synaptics,firmware-name = "synaptics_firmware_k.img";
			};

			novatek@62 {
				reg = <0x62>;
				status = "ok";
				interrupt-parent = <0xffffffff>;
				interrupts = <0x50 0x2008>;
				pinctrl-names = "pmx_ts_active\0pmx_ts_suspend\0pmx_ts_release";
				pinctrl-0 = <0xffffffff 0xffffffff>;
				pinctrl-1 = <0xffffffff 0xffffffff>;
				pinctrl-2 = <0xffffffff>;
				novatek,reset-gpio = <0xffffffff 0x56 0x00>;
				novatek,irq-gpio = <0xffffffff 0x50 0x2008>;
			};
		};
	};

	fragment@15 {
		target = <0xffffffff>;

		__overlay__ {

			synaptics_tcm@20 {
				status = "disabled";
			};

			novatek@62 {
				status = "disabled";
			};
		};
	};

	fragment@16 {
		target = <0xffffffff>;

		__overlay__ {

			rt1711h_int_n {
				phandle = <0x0b>;

				mux {
					pins = "gpio93";
					function = "gpio";
				};

				config {
					pins = "gpio93";
					drive-strength = <0x02>;
					bias-pull-up;
				};
			};
		};
	};

	fragment@17 {
		target = <0xffffffff>;

		__overlay__ {

			rt1711h@4e {
				compatible = "richtek,rt1711h";
				reg = <0x4e>;
				status = "okay";
				#io-channel-cells = <0x01>;
				tcpc-dual,supported_modes = <0x00>;
				rt-tcpc,name = "type_c_port0";
				rt-tcpc,role_def = <0x05>;
				rt-tcpc,rp_level = <0x01>;
				rt-tcpc,vconn_supply = <0x01>;
				rt1711pd,intr_gpio = <0xffffffff 0x5d 0x00>;
				rt1711pd,intr_gpio_num = <0x5d>;
				pinctrl-names = "default";
				pinctrl-0 = <0x0b>;

				pd-data {
					pd,vid = <0x29cf>;
					pd,pid = <0x1711>;
					pd,source-cap-ext = [cf 29 11 17 00 00 00 00 00 00 00 00 00 00 00 00 00 00 00 00 00 00 01 02 00];
					pd,mfrs = "RichtekTCPC";
					pd,charging_policy = <0x31>;
					pd,source-pdo-size = <0x01>;
					pd,source-pdo-data = <0x19032>;
					pd,sink-pdo-size = <0x01>;
					pd,sink-pdo-data = <0x190c8>;
					pd,id-vdo-size = <0x06>;
					pd,id-vdo-data = <0xd14029cf 0x00 0x17110000 0x61000000 0x00 0x41000000>;
					bat,nr = <0x01>;
					pd,country_nr = <0x00>;

					bat-info0 {
						bat,vid = <0x29cf>;
						bat,pid = <0x1711>;
						bat,mfrs = "bat1";
						bat,design_cap = <0xbb8>;
					};
				};

				dpm_caps {
					local_dr_power;
					local_dr_data;
					local_usb_comm;
					local_no_suspend;
					local_vconn_supply;
					attempt_enter_dp_mode;
					attempt_discover_cable;
					attempt_discover_id;
					pr_check = <0x00>;
					dr_check = <0x00>;
				};

				displayport {
					1st_connection = "dfp_d";
					2nd_connection = "dfp_d";
					signal,dp_v13;
					typec,receptacle;

					ufp_d {
					};

					dfp_d {
						pin_assignment,mode_c;
						pin_assignment,mode_d;
						pin_assignment,mode_e;
					};
				};
			};
		};
	};

	fragment@18 {
		target = <0xffffffff>;

		__overlay__ {

			rt-pd-manager {
				compatible = "richtek,rt-pd-manager";
				#io-channel-cells = <0x01>;
				io-channels = <0x0c 0x0a 0x0c 0x04 0x0c 0x0c 0x0c 0x0b 0x0c 0x00 0x0c 0x03 0x0c 0x1f 0x0c 0x1e 0x0d 0xab>;
				io-channel-names = "usb_real_type\0pd_active\0pd_voltage_min\0pd_voltage_max\0pd_current_max\0typec_cc_orientation\0pd_usb_suspend_supported\0pd_in_hard_reset\0cc_chip_id";
				phandle = <0x0d>;
			};

			xm_pd_adapter {
				compatible = "xiaomi,pd_adapter";
				adapter_name = "pd_adapter";
			};
		};
	};

	fragment@19 {
		target = <0xffffffff>;

		__overlay__ {
			extcon = <0x0d 0xffffffff>;
		};
	};

	fragment@20 {
		target = <0xffffffff>;

		__overlay__ {

			bq2589x_int_default {
				phandle = <0x0e>;

				mux {
					pins = "gpio105";
					function = "gpio";
				};

				config {
					pins = "gpio105";
					drive-strength = <0x02>;
					bias-pull-up;
					input-enable;
				};
			};

			bq2589x_usb_switch_default {
				phandle = <0x0f>;

				mux {
					pins = "gpio66";
					function = "gpio";
				};

				config {
					pins = "gpio66";
					drive-strength = <0x02>;
					bias-disable;
					output-low;
				};
			};
		};
	};

	fragment@21 {
		target = <0xffffffff>;

		__overlay__ {
			status = "ok";
			#address-cells = <0x01>;
			#size-cells = <0x00>;

			bq2589x@6A {
				#io-channel-cells = <0x01>;
				compatible = "ti,bq2589x-1";
				reg = <0x6a>;
				#address-cells = <0x01>;
				#size-cells = <0x00>;
				interrupt-parent = <0xffffffff>;
				interrupts = <0x69 0x00>;
				pinctrl-names = "default";
				pinctrl-0 = <0x0e 0x0f>;
				intr-gpio = <0xffffffff 0x69 0x00>;
				usb-switch1 = <0xffffffff 0x42 0x00>;
				dpdm-supply = <0xffffffff>;
				ti,bq2589x,vbus-volt-high-level = <0x21fc>;
				ti,bq2589x,vbus-volt-low-level = <0x1130>;
				ti,bq2589x,vbat-min-volt-to-tuneup = <0xbb8>;
				ti,bq2589x,charge-voltage = <0x1162>;
				ti,bq2589x,charge-current = <0x7d0>;
				ti,bq2589x,charge-current-1500 = <0x5dc>;
				ti,bq2589x,charge-current-1000 = <0x3e8>;
				ti,bq2589x,charge-current-500 = <0x1f4>;
				ti,bq2589x,charge-current-3500 = <0xdac>;
				ti,bq2589x,input-current-2000 = <0x7d0>;
				ti,bq2589x,term-current = <0x100>;
				ti,bq2589x,enable-auto-dpdm;
				ti,bq2589x,enable-termination;
				ti,bq2589x,enable-ico;
				ti,bq2589x,use-absolute-vindpm;
				io-channels = <0x10 0x8b 0x11 0xa2 0x11 0xb0 0x0c 0x8e 0x0c 0x0a 0x0c 0x04 0x0c 0x03 0x0c 0x01 0x0c 0xaf>;
				io-channel-names = "ds_chip_ok\0fastcharge_mode\0fg_monitor_work\0mtbf_cur\0usb_real_type\0pd_active\0typec_cc_orientation\0typec_mode\0ffc_disable";
				phandle = <0x14>;
			};

			sm5602@71 {
				#io-channel-cells = <0x01>;
				compatible = "sm,sm5602";
				reg = <0x71>;
				sm,en_temp_ex;
				sm,en_batt_det;
				sm,iocv_man_mode;
				sm,misc = <0x800>;
				sm,aging_ctrl = <0x121>;
				sm,cycle_cfg = <0x7000>;
				sm,rsns = <0x00>;
				sm,fg_irq_set = <0x7ff>;
				sm,low_soc1 = <0x01>;
				sm,low_soc2 = <0x0f>;
				sm,v_l_alarm = <0xd48>;
				sm,v_h_alarm = <0x1162>;
				sm,battery_table_num = <0x00>;
				sm,param_version = <0x06>;
				sm,t_l_alarm_in = <0x36>;
				sm,t_h_alarm_in = <0x01>;
				sm,t_l_alarm_ex = <0xd3d8>;
				sm,t_h_alarm_ex = <0x9245>;
				sm,shutdown-delay-enable;
				sm,rtrace = <0x7d0>;
				sm,soc_decimal_rate = <0x00 0x26 0x0a 0x23 0x14 0x21 0x1e 0x21 0x28 0x21 0x32 0x21 0x3c 0x21 0x46 0x1e 0x50 0x19 0x5a 0x14 0x5f 0x0a>;
				io-channels = <0x10 0x82 0x10 0x7e 0x10 0x7f 0x10 0x88 0x10 0x8b 0x0c 0x0a 0x12 0x76 0x12 0x94 0x13 0x76 0x13 0x94 0x14 0x39>;
				io-channel-names = "ds_authen_result\0ds_romid\0ds_status\0ds_page0_data\0ds_chip_ok\0usb_real_type\0charging_enabled\0sc_battery_voltage\0ln_charging_enabled\0ln_battery_voltage\0charge_done";
				phandle = <0x11>;

				battery_params {
					battery0,param_version = <0x01>;
					battery0,max_voltage_uv = <0x43e6d0>;
					battery0,battery_type = <0x1162 0x00 0x26c9>;
					battery0,battery_table0 = <0x1400 0x1b3d 0x1c5e 0x1d3a 0x1d80 0x1d8d 0x1d93 0x1daa 0x1dfa 0x1e3e 0x1e77 0x1eb2 0x1f09 0x1f67 0x1fb3 0x1fe6 0x2046 0x20eb 0x21a1 0x2220 0x227a 0x2319 0x2360 0x24cc>;
					battery0,battery_table1 = <0x00 0x68 0x1f2 0x400 0x58a 0x798 0xaac 0xcba 0x1367 0x1b1a 0x22cd 0x2a80 0x3234 0x3756 0x39e7 0x3c78 0x419a 0x494e 0x5101 0x5623 0x59bb 0x60eb 0x6400 0x64e6>;
					battery0,battery_table2 = <0x141c 0x1011 0xe0f 0xc0d 0xb0b 0xa0b 0xa0a 0x909>;
					battery0,alpha = <0xcc>;
					battery0,beta = <0x25>;
					battery0,rs = <0x5f>;
					battery0,rs_value = <0x50 0x10a 0x3800 0x48>;
					battery0,vit_period = <0x315a>;
					battery0,volt_cal = <0x8000>;
					battery0,mix_value = <0x03>;
					battery0,curr_offset = <0x00>;
					battery0,curr_slope = <0x8080>;
					battery0,topoff_soc = <0x07 0x12c 0x64>;
					battery0,temp_std = <0x19>;
					battery0,temp_offset = <0x00 0x0b 0x01 0x00 0x08 0xffffffff>;
					battery0,temp_cal = <0x00 0x06 0x01 0x0b 0xffffffff 0x00 0x06 0x01 0x09 0x01>;
					battery0,ext_temp_cal = <0x00 0x02 0x01 0x02 0x01 0x01 0x02 0x03 0x02 0x03>;
					battery0,tem_poff = <0xd48 0x64>;
					battery0,fcm_offset = <0x52>;
					battery0,thermal_table = <0x506e 0x4f35 0x4e07 0x4cc0 0x4b76 0x4a25 0x48bd 0x475d 0x45f5 0x4477 0x4304 0x4175 0x3fde 0x3e4a 0x3ca2 0x3af6 0x3945 0x378a 0x35cb 0x33fc 0x322b 0x3059 0x2e82 0x2ca0 0x2ac6 0x28c6 0x26e0 0x24ea 0x22e8 0x20ef 0x1ee7 0x1cee 0x1ae8 0x18d0 0x16d6 0x14ce 0x12f3 0x10e4 0xed6 0xcc4 0xabc 0x8bc 0x6a8 0x4ad 0x2a1 0x9e 0xf669 0xf471 0xf278 0xf081 0xee7b 0xec8c 0xeaa1 0xe8be 0xe6e1 0xe505 0xe332 0xe162 0xdf9b 0xddd9 0xdc1f 0xda67 0xd8b4 0xd70b 0xd565 0xd3c7 0xd232 0xd0a1 0xcf18 0xcd94 0xcc18 0xcaa5 0xc936 0xc7d3 0xc670 0xc519 0xc3c6 0xc27a 0xc136 0xbff7 0xbec1 0xbd92 0xbc6e 0xbb4d 0xba36 0xb922 0xb816 0xb712 0xb611 0xb517 0xb422 0xb334 0xb249 0xb164 0xb085 0xafad 0xaed8 0xae0a 0xad3e 0xac78 0xabb7>;
					battery1,param_version = <0x02>;
					battery1,max_voltage_uv = <0x43e6d0>;
					battery1,battery_type = <0x1162 0x00 0x2700>;
					battery1,battery_table0 = <0x1400 0x1b35 0x1c26 0x1cec 0x1d66 0x1d8c 0x1d97 0x1db6 0x1e00 0x1e48 0x1e7d 0x1ebd 0x1f12 0x1f70 0x1fbd 0x1fed 0x2050 0x20f3 0x21a7 0x2224 0x227b 0x2317 0x235b 0x24cc>;
					battery1,battery_table1 = <0x00 0x66 0x193 0x31b 0x4a3 0x730 0xb44 0xd4e 0x13ef 0x1b96 0x233c 0x2ae2 0x3288 0x37a2 0x3a2e 0x3cbb 0x41d5 0x497b 0x5121 0x563b 0x59cc 0x60f0 0x6400 0x64e6>;
					battery1,battery_table2 = <0x1720 0x1214 0x1011 0xd0e 0xc0c 0xb0b 0xa0a 0xa0a>;
					battery1,alpha = <0xcc>;
					battery1,beta = <0x25>;
					battery1,rs = <0x5f>;
					battery1,rs_value = <0x50 0x10a 0x3800 0x48>;
					battery1,vit_period = <0x315a>;
					battery1,volt_cal = <0x8000>;
					battery1,mix_value = <0x03>;
					battery1,curr_offset = <0x00>;
					battery1,curr_slope = <0x8080>;
					battery1,topoff_soc = <0x07 0x12c 0x64>;
					battery1,temp_std = <0x19>;
					battery1,temp_offset = <0x00 0x0b 0x01 0x00 0x08 0xffffffff>;
					battery1,temp_cal = <0x00 0x06 0x01 0x0b 0xffffffff 0x00 0x06 0x01 0x09 0x01>;
					battery1,ext_temp_cal = <0x00 0x02 0x01 0x02 0x01 0x01 0x02 0x03 0x02 0x03>;
					battery1,tem_poff = <0xd48 0x64>;
					battery1,fcm_offset = <0x67>;
					battery1,thermal_table = <0x506e 0x4f35 0x4e07 0x4cc0 0x4b76 0x4a25 0x48bd 0x475d 0x45f5 0x4477 0x4304 0x4175 0x3fde 0x3e4a 0x3ca2 0x3af6 0x3945 0x378a 0x35cb 0x33fc 0x322b 0x3059 0x2e82 0x2ca0 0x2ac6 0x28c6 0x26e0 0x24ea 0x22e8 0x20ef 0x1ee7 0x1cee 0x1ae8 0x18d0 0x16d6 0x14ce 0x12f3 0x10e4 0xed6 0xcc4 0xabc 0x8bc 0x6a8 0x4ad 0x2a1 0x9e 0xf669 0xf471 0xf278 0xf081 0xee7b 0xec8c 0xeaa1 0xe8be 0xe6e1 0xe505 0xe332 0xe162 0xdf9b 0xddd9 0xdc1f 0xda67 0xd8b4 0xd70b 0xd565 0xd3c7 0xd232 0xd0a1 0xcf18 0xcd94 0xcc18 0xcaa5 0xc936 0xc7d3 0xc670 0xc519 0xc3c6 0xc27a 0xc136 0xbff7 0xbec1 0xbd92 0xbc6e 0xbb4d 0xba36 0xb922 0xb816 0xb712 0xb611 0xb517 0xb422 0xb334 0xb249 0xb164 0xb085 0xafad 0xaed8 0xae0a 0xad3e 0xac78 0xabb7>;
					battery2,param_version = <0x01>;
					battery2,max_voltage_uv = <0x43e6d0>;
					battery2,battery_type = <0x1162 0x00 0x26c9>;
					battery2,battery_table0 = <0x1400 0x1b3d 0x1c5e 0x1d3a 0x1d80 0x1d8d 0x1d93 0x1daa 0x1dfa 0x1e3e 0x1e77 0x1eb2 0x1f09 0x1f67 0x1fb3 0x1fe6 0x2046 0x20eb 0x21a1 0x2220 0x227a 0x2319 0x2360 0x24cc>;
					battery2,battery_table1 = <0x00 0x68 0x1f2 0x400 0x58a 0x798 0xaac 0xcba 0x1367 0x1b1a 0x22cd 0x2a80 0x3234 0x3756 0x39e7 0x3c78 0x419a 0x494e 0x5101 0x5623 0x59bb 0x60eb 0x6400 0x64e6>;
					battery2,battery_table2 = <0x141c 0x1011 0xe0f 0xc0d 0xb0b 0xa0b 0xa0a 0x909>;
					battery2,alpha = <0xcc>;
					battery2,beta = <0x25>;
					battery2,rs = <0x5f>;
					battery2,rs_value = <0x50 0x10a 0x3800 0x48>;
					battery2,vit_period = <0x315a>;
					battery2,volt_cal = <0x8000>;
					battery2,mix_value = <0x03>;
					battery2,curr_offset = <0x00>;
					battery2,curr_slope = <0x8080>;
					battery2,topoff_soc = <0x07 0x12c 0x64>;
					battery2,temp_std = <0x19>;
					battery2,temp_offset = <0x00 0x0b 0x01 0x00 0x08 0xffffffff>;
					battery2,temp_cal = <0x00 0x06 0x01 0x0b 0xffffffff 0x00 0x06 0x01 0x09 0x01>;
					battery2,ext_temp_cal = <0x00 0x02 0x01 0x02 0x01 0x01 0x02 0x03 0x02 0x03>;
					battery2,tem_poff = <0xd48 0x64>;
					battery2,fcm_offset = <0x52>;
					battery2,thermal_table = <0x506e 0x4f35 0x4e07 0x4cc0 0x4b76 0x4a25 0x48bd 0x475d 0x45f5 0x4477 0x4304 0x4175 0x3fde 0x3e4a 0x3ca2 0x3af6 0x3945 0x378a 0x35cb 0x33fc 0x322b 0x3059 0x2e82 0x2ca0 0x2ac6 0x28c6 0x26e0 0x24ea 0x22e8 0x20ef 0x1ee7 0x1cee 0x1ae8 0x18d0 0x16d6 0x14ce 0x12f3 0x10e4 0xed6 0xcc4 0xabc 0x8bc 0x6a8 0x4ad 0x2a1 0x9e 0xf669 0xf471 0xf278 0xf081 0xee7b 0xec8c 0xeaa1 0xe8be 0xe6e1 0xe505 0xe332 0xe162 0xdf9b 0xddd9 0xdc1f 0xda67 0xd8b4 0xd70b 0xd565 0xd3c7 0xd232 0xd0a1 0xcf18 0xcd94 0xcc18 0xcaa5 0xc936 0xc7d3 0xc670 0xc519 0xc3c6 0xc27a 0xc136 0xbff7 0xbec1 0xbd92 0xbc6e 0xbb4d 0xba36 0xb922 0xb816 0xb712 0xb611 0xb517 0xb422 0xb334 0xb249 0xb164 0xb085 0xafad 0xaed8 0xae0a 0xad3e 0xac78 0xabb7>;
					battery3,param_version = <0x01>;
					battery3,max_voltage_uv = <0x43e6d0>;
					battery3,battery_type = <0x1162 0x00 0x26cc>;
					battery3,battery_table0 = <0x1400 0x1b32 0x1bfd 0x1cd9 0x1d76 0x1d8c 0x1d96 0x1db5 0x1dfe 0x1e43 0x1e75 0x1eb2 0x1f06 0x1f6c 0x1fb4 0x1fe2 0x2041 0x20e5 0x219c 0x221b 0x2274 0x2315 0x2361 0x24cc>;
					battery3,battery_table1 = <0x00 0x66 0x149 0x2d1 0x4dd 0x6e9 0xb01 0xd0c 0x13b2 0x1b5f 0x230b 0x2ab7 0x3263 0x3780 0x3a0f 0x3c9d 0x41bb 0x4967 0x5113 0x5630 0x59c5 0x60ee 0x6400 0x64e6>;
					battery3,battery_table2 = <0x131b 0xf11 0xe0e 0xc0c 0xb0b 0xa0a 0x90a 0x909>;
					battery3,alpha = <0xcc>;
					battery3,beta = <0x25>;
					battery3,rs = <0x5f>;
					battery3,rs_value = <0x50 0x10a 0x3800 0x48>;
					battery3,vit_period = <0x315a>;
					battery3,volt_cal = <0x8000>;
					battery3,mix_value = <0x03>;
					battery3,curr_offset = <0x00>;
					battery3,curr_slope = <0x8080>;
					battery3,topoff_soc = <0x07 0x12c 0x64>;
					battery3,temp_std = <0x19>;
					battery3,temp_offset = <0x00 0x0b 0x01 0x00 0x08 0xffffffff>;
					battery3,temp_cal = <0x00 0x06 0x01 0x0b 0xffffffff 0x00 0x06 0x01 0x09 0x01>;
					battery3,ext_temp_cal = <0x00 0x02 0x01 0x02 0x01 0x01 0x02 0x03 0x02 0x03>;
					battery3,tem_poff = <0xd48 0x64>;
					battery3,fcm_offset = <0x67>;
					battery3,thermal_table = <0x506e 0x4f35 0x4e07 0x4cc0 0x4b76 0x4a25 0x48bd 0x475d 0x45f5 0x4477 0x4304 0x4175 0x3fde 0x3e4a 0x3ca2 0x3af6 0x3945 0x378a 0x35cb 0x33fc 0x322b 0x3059 0x2e82 0x2ca0 0x2ac6 0x28c6 0x26e0 0x24ea 0x22e8 0x20ef 0x1ee7 0x1cee 0x1ae8 0x18d0 0x16d6 0x14ce 0x12f3 0x10e4 0xed6 0xcc4 0xabc 0x8bc 0x6a8 0x4ad 0x2a1 0x9e 0xf669 0xf471 0xf278 0xf081 0xee7b 0xec8c 0xeaa1 0xe8be 0xe6e1 0xe505 0xe332 0xe162 0xdf9b 0xddd9 0xdc1f 0xda67 0xd8b4 0xd70b 0xd565 0xd3c7 0xd232 0xd0a1 0xcf18 0xcd94 0xcc18 0xcaa5 0xc936 0xc7d3 0xc670 0xc519 0xc3c6 0xc27a 0xc136 0xbff7 0xbec1 0xbd92 0xbc6e 0xbb4d 0xba36 0xb922 0xb816 0xb712 0xb611 0xb517 0xb422 0xb334 0xb249 0xb164 0xb085 0xafad 0xaed8 0xae0a 0xad3e 0xac78 0xabb7>;
				};
			};
		};
	};

	fragment@22 {
		target = <0xffffffff>;

		__overlay__ {

			sc8551_int_default {
				phandle = <0x19>;

				mux {
					pins = "gpio84";
					function = "gpio";
				};

				config {
					pins = "gpio84";
					drive-strength = <0x02>;
					bias-pull-up;
					input-enable;
				};
			};
		};
	};

	fragment@23 {
		target = <0xffffffff>;

		__overlay__ {
			status = "ok";
			#address-cells = <0x01>;
			#size-cells = <0x00>;

			sc8551-charger@66 {
				#io-channel-cells = <0x01>;
				compatible = "sc,sc8551-standalone";
				reg = <0x66>;
				irq-gpios = <0xffffffff 0x54 0x00>;
				sc,sc8551,bat-therm-disable = <0x00>;
				sc,sc8551,bus-therm-disable = <0x00>;
				sc,sc8551,bat-ovp-threshold = <0x11ad>;
				sc,sc8551,bat-ovp-alarm-threshold = <0x1130>;
				sc,sc8551,bat-ocp-threshold = <0x1f40>;
				sc,sc8551,bat-ocp-alarm-threshold = <0x1d4c>;
				sc,sc8551,bus-ovp-threshold = <0x2ee0>;
				sc,sc8551,bus-ovp-alarm-threshold = <0x2af8>;
				sc,sc8551,bus-ocp-threshold = <0xea6>;
				sc,sc8551,bus-ocp-alarm-threshold = <0xdac>;
				sc,sc8551,bat-ucp-alarm-threshold = <0x7d0>;
				sc,sc8551,bat-therm-threshold = <0x15>;
				sc,sc8551,bus-therm-threshold = <0x15>;
				sc,sc8551,die-therm-threshold = <0x7d>;
				sc,sc8551,ac-ovp-threshold = <0x0c>;
				sc,sc8551,sense-resistor-mohm = <0x05>;
				phandle = <0x12>;
			};

			ln8000_charger@51 {
				#io-channel-cells = <0x01>;
				compatible = "lionsemi,ln8000-master";
				reg = <0x51>;
				irq-gpios = <0xffffffff 0x54 0x00>;
				ln8000_charger,bat-ovp-threshold = <0x11c6>;
				ln8000_charger,bat-ovp-alarm-threshold = <0x11ad>;
				ln8000_charger,bus-ovp-threshold = <0x32c8>;
				ln8000_charger,bus-ovp-alarm-threshold = <0x2af8>;
				ln8000_charger,bus-ocp-threshold = <0xea6>;
				ln8000_charger,bus-ocp-alarm-threshold = <0xdac>;
				ln8000_charger,ntc-alarm-cfg = <0xe2>;
				ln8000_charger,ext_ovp_ctrl = <0x00>;
				ln8000_charger,tdie-prot-disable;
				ln8000_charger,tbus-mon-disable;
				ln8000_charger,tbat-mon-disable;
				phandle = <0x13>;
			};
		};
	};

	fragment@24 {
		target = <0xffffffff>;

		__overlay__ {

			qcom,nopmi-chg {
				#io-channel-cells = <0x01>;
				compatible = "qcom,nopmi-chg";
				status = "okay";
				qcom,fv-max-uv = <0x432380>;
				enable_sw_jeita;
				jeita_temp_above_t4_cv = <0x1004>;
				jeita_temp_t3_to_t4_cv = <0x1004>;
				jeita_temp_t2_to_t3_cv = <0x1162>;
				jeita_temp_t1p5_to_t2_cv = <0x1162>;
				jeita_temp_t1_to_t1p5_cv = <0x1162>;
				jeita_temp_t0_to_t1_cv = <0x1162>;
				jeita_temp_tn1_to_t0_cv = <0x1162>;
				jeita_temp_below_t0_cv = <0x1162>;
				temp_t4_thres = <0x3c>;
				temp_t4_thres_minus_x_degree = <0x3a>;
				temp_t3_thres = <0x30>;
				temp_t3_thres_minus_x_degree = <0x2e>;
				temp_t2_thres = <0x0f>;
				temp_t2_thres_plus_x_degree = <0x11>;
				temp_t1p5_thres = <0x0a>;
				temp_t1p5_thres_plus_x_degree = <0x0b>;
				temp_t1_thres = <0x05>;
				temp_t1_thres_plus_x_degree = <0x06>;
				temp_t0_thres = <0x00>;
				temp_t0_thres_plus_x_degree = <0x01>;
				temp_tn1_thres = <0xfffffff6>;
				temp_tn1_thres_plus_x_degree = <0xfffffff7>;
				temp_neg_10_thres = <0xfffffff6>;
				temp_t3_to_t4_fcc = <0x92e>;
				temp_t2_to_t3_fcc = <0x173e>;
				temp_t1p5_to_t2_fcc = <0xf3c>;
				temp_t1_to_t1p5_fcc = <0x960>;
				temp_t0_to_t1_fcc = <0x3b6>;
				temp_tn1_to_t0_fcc = <0x1ea>;
				nopmi,thermal-mitigation = <0x5aca30 0x5265c0 0x4c4b40 0x44aa20 0x3d0900 0x387520 0x3567e0 0x2dc6c0 0x2ab980 0x2625a0 0x1e8480 0x16e360 0xf4240 0xc3500 0x7a120 0x55730 0xc3500 0xc3500>;
				io-channels = <0x11 0x4b 0x11 0x9f 0x11 0xa0 0x11 0xa1 0x11 0xa2 0x11 0xb1 0x14 0x74 0x14 0x9e 0x14 0xae 0x14 0x04 0x12 0x98 0x12 0x76 0x12 0xab 0x13 0x98 0x13 0x76 0x13 0xab 0x0d 0xab 0x10 0xab 0x10 0x8b 0x10 0x82>;
				io-channel-names = "resistance_id\0shutdown_delay\0soc_decimal\0soc_decimal_rate\0fastcharge_mode\0fg_batt_id\0charge_type\0charge_enabled\0charge_ic_type\0charge_pd_active\0sc_bus_current\0charging_enabled\0sc_chip_id\0ln_bus_current\0ln_charging_enabled\0ln_chip_id\0cc_chip_id\0ds_chip_id\0ds_chip_ok\0ds_authen_result";
				phandle = <0x0c>;
			};

			onewire_gpio {
				compatible = "xiaomi,onewire_gpio";
				label = "xm_onewire";
				xiaomi,version = <0x01>;
				xiaomi,ow_gpio = <0xffffffff 0x6c 0x00>;
				xiaomi,gpio_number = <0x6c>;
				mi,onewire-gpio-cfg-addr = <0x96c000 0x04>;
				pinctrl-names = "onewire_active\0onewire_sleep";
				pinctrl-0 = <0x15>;
				pinctrl-1 = <0x16>;
				status = "ok";
				phandle = <0x1a>;
			};

			maxim_ds28e16 {
				#io-channel-cells = <0x01>;
				compatible = "maxim,ds28e16";
				label = "max_ds28e16";
				maxim,version = <0x01>;
				status = "ok";
				phandle = <0x10>;
			};
		};
	};

	fragment@25 {
		target = <0xffffffff>;

		__overlay__ {

			onewire_gpio_active {
				phandle = <0x15>;

				mux {
					pins = "gpio108";
					function = "gpio";
				};

				config {
					pins = "gpio108";
					drive-strength = <0x02>;
					bias-pull-up;
				};
			};

			onewire_gpio_sleep {
				phandle = <0x16>;

				mux {
					pins = "gpio108";
					function = "gpio";
				};

				config {
					pins = "gpio108";
					drive-strength = <0x02>;
					bias-pull-up;
				};
			};
		};
	};

	fragment@26 {
		target = <0xffffffff>;

		__overlay__ {

			qcom_cp_manager {
				compatible = "qcom,cp_manager";
				status = "okay";
				io-channels = <0x12 0x90 0x12 0x76 0x12 0x8f 0x12 0x92 0x12 0x93 0x12 0x94 0x12 0x95 0x12 0x96 0x12 0x97 0x12 0x98 0x12 0x99 0x12 0x9a 0x12 0x9b 0x12 0x91 0x12 0x9c 0x12 0x9d 0x12 0xab 0x0c 0x78 0x0c 0x04 0x0c 0x76 0x14 0x9e 0x13 0x8f 0x13 0x90 0x13 0xa6 0x13 0xaa 0x13 0xa7 0x13 0x76 0x13 0xa4 0x13 0xa5 0x13 0x92 0x13 0x93 0x13 0x94 0x13 0x95 0x13 0x96 0x13 0x97 0x13 0x98 0x13 0x99 0x13 0x9a 0x13 0x9b 0x13 0x91 0x13 0xa8 0x13 0xa9 0x13 0x9c 0x13 0xab 0x0c 0xac 0x0c 0xad>;
				io-channel-names = "present\0charging_enabled\0status\0sc_battery_present\0sc_vbus_present\0sc_battery_voltage\0sc_battery_current\0sc_battery_temperature\0sc_bus_voltage\0sc_bus_current\0sc_bus_temperature\0sc_die_temperature\0sc_alarm_status\0sc_fault_status\0sc_vbus_error_status\0sc_chip_vendor\0sc_chip_id\0input_suspend\0pd_active\0battery_charging_enabled\0charge_enabled\0ln_status\0ln_present\0ln_constant_charge_voltage\0ln_input_current_limit\0ln_model_name\0ln_charging_enabled\0ln_ti_bypass_mode_enable\0ln_ti_set_bus_protection_for_qc3\0ln_battery_present\0ln_vbus_present\0ln_battery_voltage\0ln_battery_current\0ln_battery_temperture\0ln_bus_voltage\0ln_bus_current\0ln_bus_temperature\0ln_die_temperature\0ln_alarm_status\0ln_fault_status\0ln_ti_reg_status\0ln_hv_charge_enable\0ln_vbus_error_status\0ln_chip_id\0apdo_volt\0apdo_curr";
			};
		};
	};

	fragment@27 {
		target = <0xffffffff>;

		__overlay__ {
			cd-gpios = <0xffffffff 0x58 0x00>;
		};
	};

	fragment@28 {
		target = <0xffffffff>;

		__overlay__ {

			simtray {
				compatible = "xiaomi,simtray-status";
				status-gpio = <0xffffffff 0x4f 0x00>;
			};

			thermal-message {
				board-sensor = "VIRTUAL-SENSOR";
				phandle = <0x1b>;
			};
		};
	};

	fragment@29 {
		target = <0xffffffff>;

		__overlay__ {
			status = "disabled";
		};
	};

	fragment@30 {
		target = <0xffffffff>;

		__overlay__ {
			status = "ok";
			qcom,clk-freq-out = <0x61a80>;
			#address-cells = <0x01>;
			#size-cells = <0x00>;

			st_st21nfc@08 {
				compatible = "st,st21nfc";
				reg = <0x08>;
				st,irq-gpio = <0xffffffff 0x46 0x00>;
				st,reset-gpio = <0xffffffff 0x45 0x00>;
				st,clkreq-gpio = <0xffffffff 0x47 0x00>;
				interrupt-parent = <0xffffffff>;
				interrupts = <0x46 0x00>;
				interrupt-names = "nfc_irq";
				clock-names = "nfc_ref_clk";
				st,clk_pinctrl;
			};
		};
	};

	__symbols__ {
		si_pa_L = "/fragment@34/__overlay__/si_pa_L";
		clock_audio_va_2 = "/fragment@34/__overlay__/va_npl_clk";
		clock_audio_va_1 = "/fragment@34/__overlay__/va_core_clk";
		clock_audio_tx_2 = "/fragment@34/__overlay__/tx_npl_clk";
		clock_audio_tx_1 = "/fragment@34/__overlay__/tx_core_clk";
		clock_audio_rx_2 = "/fragment@34/__overlay__/rx_npl_clk";
		clock_audio_rx_1 = "/fragment@34/__overlay__/rx_core_clk";
		wsa881x_analog_clk = "/fragment@34/__overlay__/wsa_ana_clk";
		wsa881x_analog_reset_gpio = "/fragment@34/__overlay__/msm_cdc_pinctrl@106";
		wcd937x_rst_gpio = "/fragment@34/__overlay__/msm_cdc_pinctrl@92";
		sipa_i2c_L = "/fragment@33/__overlay__/sipa_i2c_L@2b";
		wsa881x_i2c_44 = "/fragment@33/__overlay__/wsa881x-i2c-codec@44";
		wsa881x_i2c_e = "/fragment@33/__overlay__/wsa881x-i2c-codec@e";
		cdc_sec_mi2s_gpios = "/fragment@32/__overlay__/sec_mi2s_pinctrl";
		cdc_pri_mi2s_gpios = "/fragment@32/__overlay__/pri_mi2s_pinctrl";
		bengal_snd = "/fragment@32/__overlay__/sound";
		wcd937x_codec = "/fragment@31/__overlay__/wcd937x-codec";
		wcd937x_tx_slave = "/fragment@31/__overlay__/va-macro@a730000/va_swr_master/wcd937x-tx-slave";
		swr0 = "/fragment@31/__overlay__/va-macro@a730000/va_swr_master";
		va_macro = "/fragment@31/__overlay__/va-macro@a730000";
		wcd937x_rx_slave = "/fragment@31/__overlay__/rx-macro@a600000/rx_swr_master/wcd937x-rx-slave";
		swr1 = "/fragment@31/__overlay__/rx-macro@a600000/rx_swr_master";
		rx_macro = "/fragment@31/__overlay__/rx-macro@a600000";
		tx_macro = "/fragment@31/__overlay__/tx-macro@a620000";
		msm_gpio_104 = "/fragment@2/__overlay__/msm_gpio_104";
		msm_gpio_104_output_high = "/fragment@2/__overlay__/msm_gpio_104_output_high";
		msm_gpio_83 = "/fragment@2/__overlay__/msm_gpio_83";
		msm_gpio_65 = "/fragment@2/__overlay__/msm_gpio_65";
		msm_gpio_65_output_high = "/fragment@2/__overlay__/msm_gpio_65_output_high";
		oled_vci_default = "/fragment@6/__overlay__/oled_vci/oled_vci_default";
		oled_vci_suspend = "/fragment@6/__overlay__/oled_vci/oled_vci_suspend";
		rf_pa1_therm_default = "/fragment@6/__overlay__/rf_pa1_therm/rf_pa1_therm_default";
		vib_out_gpio8_default = "/fragment@6/__overlay__/vib_out_gpio8/vib_out_gpio8_default";
		key_vol_up_default = "/fragment@6/__overlay__/key_vol_up/key_vol_up_default";
		usb_eldo9 = "/fragment@6/__overlay__/eldo9_pin/gpio@c000";
		vdda_usb_ss_dp_core = "/fragment@7/__overlay__/vdda_usb_ss_dp_core";
		rt1711h_int_n = "/fragment@16/__overlay__/rt1711h_int_n";
		rpm = "/fragment@18/__overlay__/rt-pd-manager";
		bq2589x_int_default = "/fragment@20/__overlay__/bq2589x_int_default";
		bq2589x_usb_switch_default = "/fragment@20/__overlay__/bq2589x_usb_switch_default";
		bq2589x = "/fragment@21/__overlay__/bq2589x@6A";
		sm5602 = "/fragment@21/__overlay__/sm5602@71";
		sc8551_int_default = "/fragment@22/__overlay__/sc8551_int_default";
		sc8551_standalone = "/fragment@23/__overlay__/sc8551-charger@66";
		ln8000_charger = "/fragment@23/__overlay__/ln8000_charger@51";
		nopmi_chg = "/fragment@24/__overlay__/qcom,nopmi-chg";
		onewire_gpio = "/fragment@24/__overlay__/onewire_gpio";
		maxim_ds28e16 = "/fragment@24/__overlay__/maxim_ds28e16";
		onewire_gpio_active = "/fragment@25/__overlay__/onewire_gpio_active";
		onewire_gpio_sleep = "/fragment@25/__overlay__/onewire_gpio_sleep";
		thermal_message = "/fragment@28/__overlay__/thermal-message";
	};

	__fixups__ {
		adsp_loader = "/fragment@35:target:0";
		spkr_1_sd_n_sleep = "/fragment@34/__overlay__/msm_cdc_pinctrl@106:pinctrl-1:0";
		spkr_1_sd_n_active = "/fragment@34/__overlay__/msm_cdc_pinctrl@106:pinctrl-0:0";
		wcd937x_reset_sleep = "/fragment@34/__overlay__/msm_cdc_pinctrl@92:pinctrl-1:0";
		wcd937x_reset_active = "/fragment@34/__overlay__/msm_cdc_pinctrl@92:pinctrl-0:0";
		wsa881x_analog_clk_gpio = "/fragment@33/__overlay__/wsa881x-i2c-codec@e:qcom,wsa-analog-clk-gpio:0";
		lpi_i2s2_sd1_sleep = "/fragment@32/__overlay__/sec_mi2s_pinctrl:pinctrl-1:12";
		lpi_i2s2_sd0_sleep = "/fragment@32/__overlay__/sec_mi2s_pinctrl:pinctrl-1:8";
		lpi_i2s2_ws_sleep = "/fragment@32/__overlay__/sec_mi2s_pinctrl:pinctrl-1:4";
		lpi_i2s2_sck_sleep = "/fragment@32/__overlay__/sec_mi2s_pinctrl:pinctrl-1:0";
		lpi_i2s2_sd1_active = "/fragment@32/__overlay__/sec_mi2s_pinctrl:pinctrl-0:12";
		lpi_i2s2_sd0_active = "/fragment@32/__overlay__/sec_mi2s_pinctrl:pinctrl-0:8";
		lpi_i2s2_ws_active = "/fragment@32/__overlay__/sec_mi2s_pinctrl:pinctrl-0:4";
		lpi_i2s2_sck_active = "/fragment@32/__overlay__/sec_mi2s_pinctrl:pinctrl-0:0";
		lpi_i2s1_sd1_sleep = "/fragment@32/__overlay__/pri_mi2s_pinctrl:pinctrl-1:12";
		lpi_i2s1_sd0_sleep = "/fragment@32/__overlay__/pri_mi2s_pinctrl:pinctrl-1:8";
		lpi_i2s1_ws_sleep = "/fragment@32/__overlay__/pri_mi2s_pinctrl:pinctrl-1:4";
		lpi_i2s1_sck_sleep = "/fragment@32/__overlay__/pri_mi2s_pinctrl:pinctrl-1:0";
		lpi_i2s1_sd1_active = "/fragment@32/__overlay__/pri_mi2s_pinctrl:pinctrl-0:12";
		lpi_i2s1_sd0_active = "/fragment@32/__overlay__/pri_mi2s_pinctrl:pinctrl-0:8";
		lpi_i2s1_ws_active = "/fragment@32/__overlay__/pri_mi2s_pinctrl:pinctrl-0:4";
		lpi_i2s1_sck_active = "/fragment@32/__overlay__/pri_mi2s_pinctrl:pinctrl-0:0";
		lpi_tlmm = "/fragment@32/__overlay__/sound:qcom,msm_audio_ssr_devs:4";
		audio_gpr = "/fragment@32/__overlay__/sound:qcom,msm_audio_ssr_devs:0";
		stub_codec = "/fragment@32/__overlay__/sound:asoc-codec:0";
		adsp_variant = "/fragment@32/__overlay__/sound:nvmem-cells:0\0/fragment@35/__overlay__:nvmem-cells:0";
		cdc_dmic23_gpios = "/fragment@32/__overlay__/sound:qcom,cdc-dmic23-gpios:0";
		cdc_dmic01_gpios = "/fragment@32/__overlay__/sound:qcom,cdc-dmic01-gpios:0";
		spf_core_platform = "/fragment@32:target:0";
		L14A = "/fragment@31/__overlay__/wcd937x-codec:cdc-vdd-buck-supply:0";
		L9A = "/fragment@31/__overlay__/wcd937x-codec:cdc-vdd-rxtx-supply:0\0/fragment@31/__overlay__/wcd937x-codec:cdc-vddpx-supply:0";
		va_swr_gpios = "/fragment@31/__overlay__/va-macro@a730000:qcom,va-swr-gpios:0";
		lpass_audio_hw_vote = "/fragment@31/__overlay__/rx-macro@a600000/rx_swr_master:clocks:0\0/fragment@31/__overlay__/va-macro@a730000:clocks:0\0/fragment@31/__overlay__/va-macro@a730000/va_swr_master:clocks:0";
		rx_swr_gpios = "/fragment@31/__overlay__/rx-macro@a600000:qcom,rx-swr-gpios:0";
		bolero_cdc = "/fragment@31:target:0\0/fragment@32/__overlay__/sound:asoc-codec:4\0/fragment@32/__overlay__/sound:qcom,msm_audio_ssr_devs:8";
		thermal_zones = "/fragment@0:target:0\0/fragment@5:target:0";
		pm6125_trip0 = "/fragment@0/__overlay__/pm6125-tz/cooling-maps/trip0_cpu0:trip:0\0/fragment@0/__overlay__/pm6125-tz/cooling-maps/trip0_cpu4:trip:0";
		CPU0 = "/fragment@0/__overlay__/pm6125-tz/cooling-maps/trip0_cpu0:cooling-device:0";
		CPU4 = "/fragment@0/__overlay__/pm6125-tz/cooling-maps/trip0_cpu4:cooling-device:0";
		pm6125_trip1 = "/fragment@0/__overlay__/pm6125-tz/cooling-maps/trip1_cpu1:trip:0\0/fragment@0/__overlay__/pm6125-tz/cooling-maps/trip1_cpu2:trip:0\0/fragment@0/__overlay__/pm6125-tz/cooling-maps/trip1_cpu3:trip:0\0/fragment@0/__overlay__/pm6125-tz/cooling-maps/trip1_cpu4:trip:0\0/fragment@0/__overlay__/pm6125-tz/cooling-maps/trip1_cpu5:trip:0\0/fragment@0/__overlay__/pm6125-tz/cooling-maps/trip1_cpu6:trip:0\0/fragment@0/__overlay__/pm6125-tz/cooling-maps/trip1_cpu7:trip:0";
		cpu1_pause = "/fragment@0/__overlay__/pm6125-tz/cooling-maps/trip1_cpu1:cooling-device:0";
		cpu2_pause = "/fragment@0/__overlay__/pm6125-tz/cooling-maps/trip1_cpu2:cooling-device:0";
		cpu3_pause = "/fragment@0/__overlay__/pm6125-tz/cooling-maps/trip1_cpu3:cooling-device:0";
		cpu4_pause = "/fragment@0/__overlay__/pm6125-tz/cooling-maps/trip1_cpu4:cooling-device:0";
		cpu5_pause = "/fragment@0/__overlay__/pm6125-tz/cooling-maps/trip1_cpu5:cooling-device:0";
		cpu6_pause = "/fragment@0/__overlay__/pm6125-tz/cooling-maps/trip1_cpu6:cooling-device:0";
		cpu7_pause = "/fragment@0/__overlay__/pm6125-tz/cooling-maps/trip1_cpu7:cooling-device:0";
		soc = "/fragment@1:target:0\0/fragment@7:target:0\0/fragment@18:target:0\0/fragment@24:target:0\0/fragment@26:target:0\0/fragment@28:target:0\0/fragment@34:target:0";
		tlmm = "/fragment@1/__overlay__/fpc1020:interrupt-parent:0\0/fragment@1/__overlay__/fpc1020:fpc,gpio_rst:0\0/fragment@1/__overlay__/fpc1020:fpc,gpio_irq:0\0/fragment@1/__overlay__/fpc1020:fpc,gpio_vdd_for_plsensor:0\0/fragment@1/__overlay__/goodix_fp:interrupt-parent:0\0/fragment@1/__overlay__/goodix_fp:fp-gpio-irq:0\0/fragment@1/__overlay__/goodix_fp:fp-gpio-reset:0\0/fragment@1/__overlay__/goodix_fp:fp-gpio-pwr:0\0/fragment@2:target:0\0/fragment@7/__overlay__/ant_check:interrupt-parent:0\0/fragment@7/__overlay__/ant_check:ant_check_gpio:0\0/fragment@7/__overlay__/ant_check_div:interrupt-parent:0\0/fragment@7/__overlay__/ant_check_div:ant_check_div_gpio:0\0/fragment@10/__overlay__:cd-gpios:0\0/fragment@12/__overlay__:reset-gpios:0\0/fragment@14/__overlay__/synaptics_tcm@20:interrupt-parent:0\0/fragment@14/__overlay__/synaptics_tcm@20:synaptics,irq-gpio:0\0/fragment@14/__overlay__/synaptics_tcm@20:synaptics,reset-gpio:0\0/fragment@14/__overlay__/novatek@62:interrupt-parent:0\0/fragment@14/__overlay__/novatek@62:novatek,reset-gpio:0\0/fragment@14/__overlay__/novatek@62:novatek,irq-gpio:0\0/fragment@16:target:0\0/fragment@17/__overlay__/rt1711h@4e:rt1711pd,intr_gpio:0\0/fragment@20:target:0\0/fragment@21/__overlay__/bq2589x@6A:interrupt-parent:0\0/fragment@21/__overlay__/bq2589x@6A:intr-gpio:0\0/fragment@21/__overlay__/bq2589x@6A:usb-switch1:0\0/fragment@22:target:0\0/fragment@23/__overlay__/sc8551-charger@66:irq-gpios:0\0/fragment@23/__overlay__/ln8000_charger@51:irq-gpios:0\0/fragment@24/__overlay__/onewire_gpio:xiaomi,ow_gpio:0\0/fragment@25:target:0\0/fragment@27/__overlay__:cd-gpios:0\0/fragment@28/__overlay__/simtray:status-gpio:0\0/fragment@30/__overlay__/st_st21nfc@08:st,irq-gpio:0\0/fragment@30/__overlay__/st_st21nfc@08:st,reset-gpio:0\0/fragment@30/__overlay__/st_st21nfc@08:st,clkreq-gpio:0\0/fragment@30/__overlay__/st_st21nfc@08:interrupt-parent:0\0/fragment@33/__overlay__/fs16xx@34:fsm,rst-gpio:0\0/fragment@33/__overlay__/aw87xxx_pa_59@59:reset-gpio:0\0/fragment@34/__overlay__/si_pa_L:si,si_pa_reset:0";
		pm6125_l9 = "/fragment@1/__overlay__/fpc1020:vcc_spi-supply:0\0/fragment@1/__overlay__/fpc1020:vdd_io-supply:0\0/fragment@1/__overlay__/fpc1020:vdd_ana-supply:0\0/fragment@1/__overlay__/goodix_fp:vcc_spi_supply:0\0/fragment@1/__overlay__/goodix_fp:vcc_ana_supply:0\0/fragment@1/__overlay__/goodix_fp:vdd_io-supply:0";
		pm6125_vadc = "/fragment@3:target:0\0/fragment@4/__overlay__/rf_pa1_therm:io-channels:0";
		camera_therm_default = "/fragment@3/__overlay__:pinctrl-0:0";
		emmc_therm_default = "/fragment@3/__overlay__:pinctrl-0:4";
		pm6125_adc_tm = "/fragment@4:target:0\0/fragment@5/__overlay__/rf-pa1-therm-usr:thermal-sensors:0";
		pm6125_gpios = "/fragment@6:target:0\0/fragment@7/__overlay__/gpio_keys/vol_up:gpios:0\0/fragment@7/__overlay__/vibrator_gpio:vib,en-gpio:0\0/fragment@7/__overlay__/vdda_usb_ss_dp_core:gpio:0";
		ant_check_default = "/fragment@7/__overlay__/ant_check:pinctrl-0:0";
		ant_check_div_default = "/fragment@7/__overlay__/ant_check_div:pinctrl-0:0";
		usb_qmp_dp_phy = "/fragment@8:target:0";
		sdhc_1 = "/fragment@9:target:0";
		L24A = "/fragment@9/__overlay__:vdd-supply:0\0/fragment@12/__overlay__:vcc-supply:0";
		L11A = "/fragment@9/__overlay__:vdd-io-supply:0\0/fragment@12/__overlay__:vccq2-supply:0";
		sdc1_on = "/fragment@9/__overlay__:pinctrl-0:0";
		sdc1_off = "/fragment@9/__overlay__:pinctrl-1:0";
		sdhc_2 = "/fragment@10:target:0\0/fragment@27:target:0";
		L22A = "/fragment@10/__overlay__:vdd-supply:0";
		L5A = "/fragment@10/__overlay__:vdd-io-supply:0";
		L7A = "/fragment@10/__overlay__:vdd-io-bias-supply:0";
		sdc2_on = "/fragment@10/__overlay__:pinctrl-0:0";
		sdc2_off = "/fragment@10/__overlay__:pinctrl-1:0";
		ufsphy_mem = "/fragment@11:target:0";
		L4A = "/fragment@11/__overlay__:vdda-phy-supply:0";
		L18A = "/fragment@11/__overlay__:vdda-pll-supply:0\0/fragment@12/__overlay__:qcom,vddp-ref-clk-supply:0";
		ufshc_mem = "/fragment@12:target:0";
		gcc_ufs_phy_gdsc = "/fragment@12/__overlay__:vdd-hba-supply:0";
		pm6125_pwm = "/fragment@13:target:0";
		qupv3_se2_i2c = "/fragment@14:target:0\0/fragment@15:target:0";
		ts_int_active = "/fragment@14/__overlay__/synaptics_tcm@20:pinctrl-0:0\0/fragment@14/__overlay__/novatek@62:pinctrl-0:0";
		ts_reset_active = "/fragment@14/__overlay__/synaptics_tcm@20:pinctrl-0:4\0/fragment@14/__overlay__/novatek@62:pinctrl-0:4";
		ts_int_suspend = "/fragment@14/__overlay__/synaptics_tcm@20:pinctrl-1:0\0/fragment@14/__overlay__/novatek@62:pinctrl-1:0";
		ts_reset_suspend = "/fragment@14/__overlay__/synaptics_tcm@20:pinctrl-1:4\0/fragment@14/__overlay__/novatek@62:pinctrl-1:4";
		ts_release = "/fragment@14/__overlay__/synaptics_tcm@20:pinctrl-2:0\0/fragment@14/__overlay__/novatek@62:pinctrl-2:0";
		qupv3_se1_i2c = "/fragment@17:target:0\0/fragment@21:target:0\0/fragment@23:target:0\0/fragment@33:target:0";
		usb0 = "/fragment@19:target:0";
		eud = "/fragment@19/__overlay__:extcon:4";
		usb2_phy0 = "/fragment@21/__overlay__/bq2589x@6A:dpdm-supply:0";
		qupv3_se4_2uart = "/fragment@29:target:0";
		qupv3_se4_i2c = "/fragment@30:target:0";
	};

	__local_fixups__ {

		fragment@1 {

			__overlay__ {

				fpc1020 {
					pinctrl-0 = <0x00>;
					pinctrl-1 = <0x00>;
					pinctrl-2 = <0x00>;
				};

				goodix_fp {
					pinctrl-0 = <0x00>;
					pinctrl-1 = <0x00>;
					pinctrl-2 = <0x00>;
					pinctrl-3 = <0x00>;
				};
			};
		};

		fragment@3 {

			__overlay__ {
				pinctrl-0 = <0x08>;
			};
		};

		fragment@7 {

			__overlay__ {

				gpio_keys {
					pinctrl-0 = <0x00>;
				};

				vibrator_gpio {
					pinctrl-0 = <0x00>;
				};

				vdda_usb_ss_dp_core {
					pinctrl-0 = <0x00>;
				};
			};
		};

		fragment@8 {

			__overlay__ {
				vdd-supply = <0x00>;
			};
		};

		fragment@17 {

			__overlay__ {

				rt1711h@4e {
					pinctrl-0 = <0x00>;
				};
			};
		};

		fragment@18 {

			__overlay__ {

				rt-pd-manager {
					io-channels = <0x00 0x08 0x10 0x18 0x20 0x28 0x30 0x38 0x40>;
				};
			};
		};

		fragment@19 {

			__overlay__ {
				extcon = <0x00>;
			};
		};

		fragment@21 {

			__overlay__ {

				bq2589x@6A {
					pinctrl-0 = <0x00 0x04>;
					io-channels = <0x00 0x08 0x10 0x18 0x20 0x28 0x30 0x38 0x40>;
				};

				sm5602@71 {
					io-channels = <0x00 0x08 0x10 0x18 0x20 0x28 0x30 0x38 0x40 0x48 0x50>;
				};
			};
		};

		fragment@24 {

			__overlay__ {

				qcom,nopmi-chg {
					io-channels = <0x00 0x08 0x10 0x18 0x20 0x28 0x30 0x38 0x40 0x48 0x50 0x58 0x60 0x68 0x70 0x78 0x80 0x88 0x90 0x98>;
				};

				onewire_gpio {
					pinctrl-0 = <0x00>;
					pinctrl-1 = <0x00>;
				};
			};
		};

		fragment@26 {

			__overlay__ {

				qcom_cp_manager {
					io-channels = <0x00 0x08 0x10 0x18 0x20 0x28 0x30 0x38 0x40 0x48 0x50 0x58 0x60 0x68 0x70 0x78 0x80 0x88 0x90 0x98 0xa0 0xa8 0xb0 0xb8 0xc0 0xc8 0xd0 0xd8 0xe0 0xe8 0xf0 0xf8 0x100 0x108 0x110 0x118 0x120 0x128 0x130 0x138 0x140 0x148 0x150 0x158 0x160 0x168>;
				};
			};
		};

		fragment@31 {

			__overlay__ {

				bolero-clk-rsc-mngr {
					clocks = <0x00 0x08 0x10 0x18 0x20 0x28>;
				};

				tx-macro@a620000 {
					clocks = <0x00 0x08>;
				};

				rx-macro@a600000 {
					clocks = <0x00 0x08>;
				};

				wcd937x-codec {
					qcom,tx-slave = <0x00>;
					qcom,rx-slave = <0x00>;
					qcom,wcd-rst-gpio-node = <0x00>;
				};
			};
		};

		fragment@32 {

			__overlay__ {

				sound {
					si,sia81xx-aux-devs = <0x00>;
					asoc-codec = <0x08>;
				};
			};
		};

		fragment@33 {

			__overlay__ {

				wsa881x-i2c-codec@e {
					qcom,wsa-analog-reset-gpio = <0x00>;
					clocks = <0x00>;
				};

				sipa_i2c_L@2b {
					si,sipa-dev = <0x00>;
				};
			};
		};
	};

	fragment@31 {
		target = <0xffffffff>;

		__overlay__ {
			qcom,bolero-version = <0x05>;
			qcom,num-macros = <0x03>;

			bolero-clk-rsc-mngr {
				clocks = <0x1c 0x00 0x1d 0x00 0x1e 0x00 0x1f 0x00 0x20 0x00 0x21 0x00>;
				clock-names = "tx_core_clk\0tx_npl_clk\0rx_core_clk\0rx_npl_clk\0va_core_clk\0va_npl_clk";
				qcom,va_mclk_mode_muxsel = "\nz\0";
				qcom,rx_mclk_mode_muxsel = <0xa5640d8>;
				qcom,fs-gen-sequence = <0x3000 0x01 0x01 0x3004 0x03 0x03 0x3004 0x03 0x01 0x3080 0x02 0x02>;
				compatible = "qcom,bolero-clk-rsc-mngr";
			};

			tx-macro@a620000 {
				phandle = <0x29>;
				qcom,is-used-swr-gpio = <0x00>;
				qcom,tx-dmic-sample-rate = <0x249f00>;
				clocks = <0x1c 0x00 0x1d 0x00>;
				clock-names = "tx_core_clk\0tx_npl_clk";
				reg = <0xa620000 0x00>;
				compatible = "qcom,tx-macro";
			};

			rx-macro@a600000 {
				phandle = <0x2a>;
				qcom,default-clk-id = <0x00>;
				qcom,rx-bcl-pmic-params = [00 04 3e];
				qcom,rx_mclk_mode_muxsel = <0xa5640d8>;
				qcom,rx-swr-gpios = <0xffffffff>;
				clocks = <0x1e 0x00 0x1f 0x00>;
				clock-names = "rx_core_clk\0rx_npl_clk";
				reg = <0xa600000 0x00>;
				compatible = "qcom,rx-macro";

				rx_swr_master {
					phandle = <0x2b>;
					qcom,swr-clock-stop-mode0 = <0x01>;
					qcom,disable-div2-clk-switch = <0x01>;
					qcom,swr-num-dev = <0x01>;
					qcom,swr-port-mapping = <0x01 0x0e 0x01 0x01 0x0f 0x02 0x02 0x12 0x01 0x03 0x10 0x01 0x03 0x11 0x02 0x04 0x13 0x01 0x05 0x14 0x01 0x05 0x15 0x02>;
					qcom,swr-num-ports = <0x05>;
					interrupt-names = "swr_master_irq";
					interrupts = <0x00 0x129 0x04>;
					swrm-io-base = <0xa610000 0x00>;
					qcom,mipi-sdw-block-packing-mode = <0x01>;
					qcom,swrm-hctl-reg = <0xa6a9098>;
					qcom,swr_master_id = <0x02>;
					qcom,swr-master-version = <0x1060000>;
					clocks = <0xffffffff 0x00>;
					clock-names = "lpass_audio_hw_vote";
					#size-cells = <0x00>;
					#address-cells = <0x02>;
					compatible = "qcom,swr-mstr";

					wcd937x-rx-slave {
						phandle = <0x23>;
						reg = <0x0a 0x1170224>;
						compatible = "qcom,wcd937x-slave";
					};
				};
			};

			va-macro@a730000 {
				phandle = <0x2c>;
				qcom,va-swr-gpios = <0xffffffff>;
				qcom,is-used-swr-gpio = <0x01>;
				qcom,default-clk-id = <0x00>;
				qcom,va-island-mode-muxsel = "\nz\0";
				qcom,va-clk-mux-select = <0x01>;
				qcom,va-dmic-sample-rate = <0x927c0>;
				clocks = <0xffffffff 0x00>;
				clock-names = "lpass_audio_hw_vote";
				reg = <0xa730000 0x00>;
				compatible = "qcom,va-macro";

				va_swr_master {
					phandle = <0x2d>;
					qcom,is-always-on = <0x01>;
					qcom,swr-mstr-irq-wakeup-capable = <0x01>;
					qcom,swr-clock-stop-mode0 = <0x01>;
					qcom,swr-num-dev = <0x01>;
					qcom,swr-port-mapping = <0x01 0x2e 0x01 0x01 0x2f 0x02 0x01 0x30 0x04 0x01 0x31 0x08 0x02 0x32 0x01 0x02 0x33 0x02 0x02 0x34 0x04 0x02 0x35 0x08 0x03 0x36 0x01 0x03 0x37 0x02 0x03 0x38 0x04 0x03 0x39 0x08>;
					qcom,swr-num-ports = <0x03>;
					qcom,swr-wakeup-required = <0x01>;
					interrupt-names = "swr_master_irq\0swr_wake_irq";
					interrupts = <0x00 0x128 0x04 0x00 0x4f 0x04>;
					swrm-io-base = <0xa740000 0x00>;
					qcom,mipi-sdw-block-packing-mode = <0x01>;
					qcom,swrm-hctl-reg = <0xa7ec100>;
					qcom,swr_master_id = <0x03>;
					qcom,swr-master-version = <0x1060000>;
					clocks = <0xffffffff 0x00>;
					clock-names = "lpass_audio_hw_vote";
					#size-cells = <0x00>;
					#address-cells = <0x02>;
					compatible = "qcom,swr-mstr";

					wcd937x-tx-slave {
						phandle = <0x24>;
						reg = <0x0a 0x1170223>;
						compatible = "qcom,wcd937x-slave";
					};
				};
			};

			wcd937x-codec {
				phandle = <0x25>;
				qcom,cdc-on-demand-supplies = "cdc-vdd-buck";
				qcom,cdc-static-supplies = "cdc-vdd-rxtx\0cdc-vddpx";
				qcom,cdc-micbias3-mv = <0xa8c>;
				qcom,cdc-micbias2-mv = <0xa8c>;
				qcom,cdc-micbias1-mv = <0xa8c>;
				qcom,cdc-vdd-buck-current = <0x9eb10>;
				qcom,cdc-vdd-buck-voltage = <0x1b7740 0x1b7740>;
				cdc-vdd-buck-supply = <0xffffffff>;
				qcom,cdc-vddpx-current = <0x4e20>;
				qcom,cdc-vddpx-voltage = <0x1b7740 0x1b7740>;
				cdc-vddpx-supply = <0xffffffff>;
				qcom,cdc-vdd-rxtx-current = <0x2710>;
				qcom,cdc-vdd-rxtx-voltage = <0x1b7740 0x1b7740>;
				cdc-vdd-rxtx-supply = <0xffffffff>;
				qcom,tx-slave = <0x24>;
				qcom,rx-slave = <0x23>;
				qcom,wcd-rst-gpio-node = <0x22>;
				qcom,swr-tx-port-params = <0x01 0x00 0x00 0x01 0x01 0x00 0x01 0x00 0x00 0x01 0x01 0x00 0x01 0x00 0x01 0x00 0x00 0x01 0x02 0x00 0x01 0x00 0x02 0x00 0x01 0x00 0x01 0x00 0x01 0x00 0x01 0x00>;
				qcom,tx_swr_ch_map = <0x00 0x1e 0x01 0x493e00 0x2e 0x01 0x1f 0x01 0x493e00 0x32 0x01 0x20 0x02 0x493e00 0x33 0x02 0x22 0x01 0x00 0x31 0x02 0x23 0x02 0x00 0x32 0x02 0x1d 0x04 0x493e00 0x33 0x03 0x24 0x01 0x00 0x34 0x03 0x25 0x02 0x00 0x35 0x03 0x26 0x04 0x00 0x36 0x03 0x27 0x08 0x00 0x37>;
				qcom,rx_swr_ch_map = <0x00 0x0e 0x01 0x00 0x0e 0x00 0x0f 0x02 0x00 0x0f 0x01 0x12 0x01 0x00 0x12 0x02 0x10 0x01 0x00 0x10 0x02 0x11 0x02 0x00 0x11 0x03 0x13 0x01 0x00 0x13 0x04 0x14 0x01 0x00 0x14 0x04 0x15 0x02 0x00 0x15>;
				qcom,split-codec = <0x01>;
				compatible = "qcom,wcd937x-codec";
			};
		};
	};

	fragment@32 {
		target = <0xffffffff>;

		__overlay__ {

			sound {
				phandle = <0x2e>;
				si,sia81xx-aux-devs-prefix = "SpkrMonoL";
				si,sia81xx-aux-devs = <0x26>;
				si,sia81xx-max-num = <0x01>;
				qcom,msm_audio_ssr_devs = <0xffffffff 0xffffffff 0xffffffff>;
				qcom,wsa-aux-dev-prefix = "SpkrMono";
				qcom,wsa-max-devs = <0x00>;
				asoc-codec-names = "msm-stub-codec.1\0bolero-codec\0wcd937x_codec";
				asoc-codec = <0xffffffff 0xffffffff 0x25>;
				nvmem-cell-names = "adsp_variant";
				nvmem-cells = <0xffffffff>;
				qcom,cdc-dmic23-gpios = <0xffffffff>;
				qcom,cdc-dmic01-gpios = <0xffffffff>;
				qcom,msm-mbhc-gnd-swh = <0x01>;
				qcom,msm-mbhc-hphl-swh = <0x01>;
				qcom,msm-mbhc-usbc-audio-supported = <0x00>;
				qcom,audio-routing = "AMIC1\0Analog Mic1\0AMIC1\0MIC BIAS1\0AMIC2\0Analog Mic2\0AMIC2\0MIC BIAS2\0AMIC3\0Analog Mic3\0AMIC3\0MIC BIAS3\0TX DMIC0\0Digital Mic0\0TX DMIC0\0MIC BIAS1\0TX DMIC1\0Digital Mic1\0TX DMIC1\0MIC BIAS1\0TX DMIC2\0Digital Mic2\0TX DMIC2\0MIC BIAS3\0TX DMIC3\0Digital Mic3\0TX DMIC3\0MIC BIAS3\0IN1_HPHL\0HPHL_OUT\0IN2_HPHR\0HPHR_OUT\0IN3_AUX\0AUX_OUT\0RX_TX DEC0_INP\0TX DEC0 MUX\0RX_TX DEC1_INP\0TX DEC1 MUX\0RX_TX DEC2_INP\0TX DEC2 MUX\0RX_TX DEC3_INP\0TX DEC3 MUX\0TX SWR_INPUT\0WCD_TX_OUTPUT\0VA SWR_INPUT\0VA_SWR_CLK\0VA SWR_INPUT\0WCD_TX_OUTPUT\0TX_AIF1 CAP\0VA_SWR_CLK\0TX_AIF2 CAP\0VA_SWR_CLK\0TX_AIF3 CAP\0VA_SWR_CLK";
				qcom,rxtx-bolero-codec = <0x01>;
				qcom,va-bolero-codec = <0x01>;
				qcom,wcn-btfm = <0x01>;
				qcom,msm-mi2s-master = <0x01 0x01 0x01 0x01>;
				qcom,model = "bengal-idp-snd-card";
			};

			pri_mi2s_pinctrl {
				phandle = <0x2f>;
				#gpio-cells = <0x00>;
				qcom,lpi-gpios;
				pinctrl-1 = <0xffffffff 0xffffffff 0xffffffff 0xffffffff>;
				pinctrl-0 = <0xffffffff 0xffffffff 0xffffffff 0xffffffff>;
				pinctrl-names = "aud_active\0aud_sleep";
				compatible = "qcom,msm-cdc-pinctrl";
			};

			sec_mi2s_pinctrl {
				phandle = <0x30>;
				#gpio-cells = <0x00>;
				qcom,lpi-gpios;
				pinctrl-1 = <0xffffffff 0xffffffff 0xffffffff 0xffffffff>;
				pinctrl-0 = <0xffffffff 0xffffffff 0xffffffff 0xffffffff>;
				pinctrl-names = "aud_active\0aud_sleep";
				compatible = "qcom,msm-cdc-pinctrl";
			};
		};
	};

	fragment@33 {
		target = <0xffffffff>;

		__overlay__ {

			wsa881x-i2c-codec@e {
				phandle = <0x31>;
				status = "disable";
				qcom,wsa-prefix = "SpkrMono";
				qcom,wsa-analog-reset-gpio = <0x28>;
				qcom,wsa-analog-clk-gpio = <0xffffffff>;
				clocks = <0x27 0x00>;
				clock-names = "wsa_mclk";
				reg = <0x0e>;
				compatible = "qcom,wsa881x-i2c-codec";
			};

			wsa881x-i2c-codec@44 {
				phandle = <0x32>;
				status = "disable";
				reg = <0x44>;
				compatible = "qcom,wsa881x-i2c-codec";
			};

			fs16xx@34 {
				reg = <0x34>;
				fsm,rst-gpio = <0xffffffff 0x6a 0x00>;
				compatible = "foursemi,fs16xx";
				status = "okay";
			};

			aw87xxx_pa_59@59 {
				status = "okay";
				dev_index = <0x00>;
				aw-rx-port-id = <0xb032>;
				reset-gpio = <0xffffffff 0x6a 0x00>;
				reg = <0x59>;
				compatible = "awinic,aw87xxx_pa";
			};

			sipa_i2c_L@2b {
				phandle = <0x33>;
				si,sipa-dev = <0x26>;
				reg = <0x2b>;
				compatible = "si,sia81xx-i2c";
			};
		};
	};

	fragment@34 {
		target = <0xffffffff>;

		__overlay__ {

			msm_cdc_pinctrl@92 {
				phandle = <0x22>;
				#gpio-cells = <0x00>;
				pinctrl-1 = <0xffffffff>;
				pinctrl-0 = <0xffffffff>;
				pinctrl-names = "aud_active\0aud_sleep";
				compatible = "qcom,msm-cdc-pinctrl";
			};

			msm_cdc_pinctrl@106 {
				phandle = <0x28>;
				status = "disable";
				#gpio-cells = <0x00>;
				pinctrl-1 = <0xffffffff>;
				pinctrl-0 = <0xffffffff>;
				pinctrl-names = "aud_active\0aud_sleep";
				compatible = "qcom,msm-cdc-pinctrl";
			};

			wsa_ana_clk {
				phandle = <0x27>;
				status = "disable";
				#clock-cells = <0x01>;
				qcom,codec-lpass-clk-id = <0x301>;
				qcom,codec-lpass-ext-clk-freq = <0x927c00>;
				qcom,codec-ext-clk-src = <0x03>;
				compatible = "qcom,audio-ref-clk";
			};

			rx_core_clk {
				phandle = <0x1e>;
				#clock-cells = <0x01>;
				qcom,codec-lpass-clk-id = <0x30e>;
				qcom,codec-lpass-ext-clk-freq = <0x1588800>;
				qcom,codec-ext-clk-src = <0x05>;
				compatible = "qcom,audio-ref-clk";
			};

			rx_npl_clk {
				phandle = <0x1f>;
				#clock-cells = <0x01>;
				qcom,codec-lpass-clk-id = <0x30f>;
				qcom,codec-lpass-ext-clk-freq = <0x1588800>;
				qcom,codec-ext-clk-src = <0x06>;
				compatible = "qcom,audio-ref-clk";
			};

			tx_core_clk {
				phandle = <0x1c>;
				#clock-cells = <0x01>;
				qcom,codec-lpass-clk-id = <0x30c>;
				qcom,codec-lpass-ext-clk-freq = <0x124f800>;
				qcom,codec-ext-clk-src = <0x07>;
				compatible = "qcom,audio-ref-clk";
			};

			tx_npl_clk {
				phandle = <0x1d>;
				#clock-cells = <0x01>;
				qcom,codec-lpass-clk-id = <0x30d>;
				qcom,codec-lpass-ext-clk-freq = <0x124f800>;
				qcom,codec-ext-clk-src = <0x08>;
				compatible = "qcom,audio-ref-clk";
			};

			va_core_clk {
				phandle = <0x20>;
				#clock-cells = <0x01>;
				qcom,codec-lpass-clk-id = <0x307>;
				qcom,codec-lpass-ext-clk-freq = <0x124f800>;
				qcom,codec-ext-clk-src = <0x02>;
				compatible = "qcom,audio-ref-clk";
			};

			va_npl_clk {
				phandle = <0x21>;
				#clock-cells = <0x01>;
				qcom,codec-lpass-clk-id = <0x308>;
				qcom,codec-lpass-ext-clk-freq = <0x124f800>;
				qcom,codec-ext-clk-src = <0x0a>;
				compatible = "qcom,audio-ref-clk";
			};

			si_pa_L {
				phandle = <0x26>;
				owi_mode = <0x01>;
				channel_num = <0x00>;
				timer_task_hdl = <0x00>;
				si,si_pa_disable_pin = <0x01>;
				si,si_pa_reset = <0xffffffff 0x6a 0x00>;
				si,si_pa_type = "sia81x9";
				compatible = "si,sia81xx";
			};
		};
	};

	fragment@35 {
		target = <0xffffffff>;

		__overlay__ {
			adsp-fw-bit-values = <0x01>;
			adsp-fw-names = "adsp2";
			nvmem-cell-names = "adsp_variant";
			nvmem-cells = <0xffffffff>;
		};
	};
};
